## config/west.yml
```yaml
manifest:
  remotes:
    - name: zmkfirmware
      url-base: https://github.com/zmkfirmware
    - name: kumamuk-git
      url-base: https://github.com/kumamuk-git
  projects:
    - name: zmk
      remote: zmkfirmware
      revision: v1
      import: app/west.yml
    - name: zmk-pmw3610-driver
      remote: kumamuk-git
      revision: v1
  self:
    path: config
```
